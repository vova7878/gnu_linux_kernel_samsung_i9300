/*
 * Hardkernel Odroid HC1 board device tree source
 *
 * Copyright (c) 2017 Marek Szyprowski
 * Copyright (c) 2017 Samsung Electronics Co., Ltd.
 *		http://www.samsung.com
 *
 * This program is free software; you can redistribute it and/or modify
 * it under the terms of the GNU General Public License version 2 as
 * published by the Free Software Foundation.
*/

/dts-v1/;
#include "exynos5422-odroidxu3-common.dtsi"

/ {
	model = "Hardkernel Odroid HC1";
	compatible = "hardkernel,odroid-hc1", "samsung,exynos5800", "samsung,exynos5";
};

&usbdrd_dwc3_1 {
	dr_mode = "host";
};

&hdmi {
	status = "disabled";
};

&mmc_0 {
	status = "disabled";
};
