## Documentation/devicetree/bindings/power/exynos-avs.txt
```
* Samsung Exynos Adaptive Voltage Scaling

Required properties:
- compatible: should be "samsung,exynos5433-avs" for Exynos 5433.
- resource: the phandle for the resource which requires the AVS feature.
- vdd-supply: the phandle to the regulator that provides power to the resource.
- An empty property which is one of:
  - "samsung,avs-type-cpu-little"
  - "samsung,avs-type-cpu-big"
  is required to describe the resource type which requires the AVS feature.

Required properties for "samsung,exynos5433-avs"
- samsung,chipid-syscon: the phandle of the syscon node for the chipid
			register set.

Example 1) exynos-avs nodes in exynos5433.dtsi are as follows:

		/* Soc Common File */

		exynos_avs_cpu0: exynos-avs@0 {
			compatible = "samsung,exynos5433-avs";
			samsung,chipid-syscon = <&chipid>;
			resource = <&cpu0>;
			samsung,asv-type-cpu-little;
			status = "disabled";
		};

		exynos_avs_cpu4: exynos-avs@1 {
			compatible = "samsung,exynos5433-avs";
			samsung,chipid-syscon = <&chipid>;
			resource = <&cpu4>;
			samsung,avs-type-cpu-big;
			status = "disabled";
		 };

Example 2) The vdd-supply property of each exynos-avs node in exynos5433-tm2.dts
           is listed below.

	   	/*  Board Specific .dts File */

		&exynos_avs_cpu0 {
			vdd-supply = <&buck3_reg>;
			status = "okay";
		};

		&exynos_avs_cpu4 {
			vdd-supply = <&buck2_reg>;
			status = "okay";
		};
```

## arch/arm/hotplug/Kconfig
```kconfig
config AUTOSMP
	bool "Multi-core automatic hotplug support"
	depends on SMP && HOTPLUG_CPU
	help
	  Automatically hotplugs the multiple cpu cores on and off
	  based on cpu load and suspend state
```

## drivers/input/keyboard/cypress-v2/Kconfig
```kconfig
#
# Cypress touchkey configuration
#

config KEYBOARD_CYPRESS_TOUCH_V2
	tristate "Cypress touchkey v2 support"
	depends on MACH_M0 && TARGET_LOCALE_EUR
	help
	  Say Y here to enable the cypress touchkey.

	  To compile this driver as a module, choose M here.

config KEYBOARD_CYPRESS_TOUCH_VIRTUAL_MOUSE
	bool "Emulate mouse buttons on touch keys"
	depends on KEYBOARD_CYPRESS_TOUCH_V2 && VIRTUAL_MOUSE_EXPORT_LEFT_CLICK && VIRTUAL_MOUSE_EXPORT_RIGHT_CLICK
	help
	  Use virtual mouse driver to send BTN_LEFT/BTN_RIGHT events to X11.

	  Menu key now is right mouse button and Back key is left.
```

## drivers/input/keyboard/cypress/Kconfig
```kconfig
#
# Cypress touchkey configuration
#

config KEYBOARD_CYPRESS_TOUCH
	tristate "Cypress touchkey support"
	help
	  Say Y here to enable the cypress touchkey.

	  To compile this driver as a module, choose M here.

config KEYBOARD_CYPRESS_TOUCH_VIRTUAL_MOUSE
	bool "Emulate mouse buttons on touch keys"
	depends on KEYBOARD_CYPRESS_TOUCH && VIRTUAL_MOUSE_EXPORT_LEFT_CLICK && VIRTUAL_MOUSE_EXPORT_RIGHT_CLICK
	help
	  Use virtual mouse driver to send BTN_LEFT/BTN_RIGHT events to X11.

	  Menu key now is right mouse button and Back key is left.

config TOUCHKEY_BLN
	bool "BLN Support"
	depends on KEYBOARD_CYPRESS_TOUCH
	help
	  BLN support.
```

## drivers/sensorhub/Kconfig
```kconfig
#
# sensor drivers configuration
#

config SENSORS_SSP_ATMEL
	tristate "Sensors ssp ATMEL"
	default n
	depends on I2C
	help
	  ssp driver for ATMEL sensor hub.
          If you say yes here you get ssp support for
	  sensor hub.
	  To compile this driver as a module, choose M here: the
	  module will be called ssp.

source "drivers/sensorhub/atmel/Kconfig"
```
